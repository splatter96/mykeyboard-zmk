## boards/shields/clickety/Kconfig.defconfig
```kconfig
if SHIELD_CLICKETY_LEFT

# Name must be less than 16 characters long!
config ZMK_KEYBOARD_NAME
    default "Clickety"

config ZMK_SPLIT_ROLE_CENTRAL
    default y

endif

if SHIELD_CLICKETY_LEFT || SHIELD_CLICKETY_RIGHT

config ZMK_SPLIT
    default y

endif
```

## boards/shields/clickety/Kconfig.shield
```kconfig
# No whitespace after the comma or in your part name!
config SHIELD_CLICKETY_LEFT
    def_bool $(shields_list_contains,clickety_left)

# No whitespace after the comma or in your part name!
config SHIELD_CLICKETY_RIGHT
    def_bool $(shields_list_contains,clickety_right)
```
